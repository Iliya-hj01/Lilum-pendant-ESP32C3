## sdkconfig.defaults
```kconfig
# Route ESP_LOG / printf output over the built-in USB Serial/JTAG peripheral
# (GPIO18 D- / GPIO19 D+) instead of UART0.
CONFIG_ESP_CONSOLE_USB_SERIAL_JTAG=y

# Arduino framework requires 1000 Hz tick rate.
CONFIG_FREERTOS_HZ=1000

# 4 MB flash (ESP32-C3-FH4 built-in flash).
CONFIG_ESPTOOLPY_FLASHSIZE_4MB=y

# Enable BLE with NimBLE stack.
CONFIG_BT_ENABLED=y
CONFIG_BT_NIMBLE_ENABLED=y
```
